## configs/mx6qsabreauto_optee_defconfig
```kconfig
CONFIG_ARM=y
CONFIG_ARCH_MX6=y
CONFIG_TARGET_MX6QSABREAUTO=y
CONFIG_SYS_EXTRA_OPTIONS="IMX_CONFIG=board/freescale/mx6qsabreauto/imximage.cfg,MX6Q,TEE_RAM_SIZE=0x2000000"
CONFIG_CMD_GPIO=y
```
